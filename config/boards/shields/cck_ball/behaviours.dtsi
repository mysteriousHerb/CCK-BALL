mt_tp: mod_tap {
    compatible = "zmk,behavior-hold-tap";
    #binding-cells = <2>;
    flavor = "balanced";
    tapping-term-ms = <400>;
    bindings = <&kp>, <&kp>;
    display-name = "Mod-Tap";
};